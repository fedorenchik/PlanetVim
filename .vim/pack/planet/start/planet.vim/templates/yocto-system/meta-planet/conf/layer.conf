## .vim/pack/planet/start/planet.vim/templates/yocto-system/meta-planet/conf/layer.conf
```bitbake
BBPATH .= ":${LAYERDIR}"
BBFILES += "${LAYERDIR}/recipes-*/*/*.bb ${LAYERDIR}/recipes-*/*/*.bbappend"
BBFILE_COLLECTIONS += "planet"
BBFILE_PATTERN_planet = "^${LAYERDIR}/"
BBFILE_PRIORITY_planet = "6"
LAYERSERIES_COMPAT_planet = "scarthgap"
```
